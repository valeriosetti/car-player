## Config.in
```kconfig
source "$BR2_EXTERNAL_CAR_PLAYER_PATH/package/dabon-cli/Config.in"
source "$BR2_EXTERNAL_CAR_PLAYER_PATH/package/devmem2/Config.in"
source "$BR2_EXTERNAL_CAR_PLAYER_PATH/package/hidraw-touch/Config.in"
source "$BR2_EXTERNAL_CAR_PLAYER_PATH/package/dabon-player/Config.in"
source "$BR2_EXTERNAL_CAR_PLAYER_PATH/package/dabon-radio/Config.in"
source "$BR2_EXTERNAL_CAR_PLAYER_PATH/package/launcher/Config.in"
source "$BR2_EXTERNAL_CAR_PLAYER_PATH/package/lvgl/Config.in"
```

## package/dabon-dashboard/Config.in
```kconfig
config BR2_PACKAGE_DABON_DASHBOARD
	bool "dabon"
	help
		DABon dashboard.

		http://example.com
```

## package/dabon-radio/Config.in
```kconfig
config BR2_PACKAGE_DABON_RADIO
	bool "dabon-radio"
	help
		DABon radio.

		http://example.com
```

## package/launcher/Config.in
```kconfig
config BR2_PACKAGE_LAUNCHER
	bool "Apps launcher"
	help
		Apps launcher.

		http://example.com
```
